## zmk-extra/sat-window-cycle/Kconfig
```kconfig
config ZMK_BEHAVIOR_SAT_WINDOW_CYCLE
    bool
    default y
    depends on DT_HAS_ZMK_BEHAVIOR_SAT_WINDOW_CYCLE_ENABLED
```

## zmk-extra/sat-window-cycle/dts/bindings/behaviors/zmk,behavior-sat-window-cycle.yaml
```yaml
# Copyright (c) 2026 Xiaolin Radiology
# SPDX-License-Identifier: MIT

description: Stateful Super Alt-Tab window cycle behavior
compatible: "zmk,behavior-sat-window-cycle"
include: zero_param.yaml

properties:
  bindings:
    type: phandle-array
    required: true
  timeout-ms:
    type: int
    required: false
    default: 1000
  ignored-key-positions:
    type: array
    required: true
```
